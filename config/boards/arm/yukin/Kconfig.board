## config/boards/arm/yukin/Kconfig.board
```kconfig
# BlueMicro840 board configuration

# Copyright (c) 2020 Pete Johanson, Derek Schmell
# SPDX-License-Identifier: MIT

config BOARD_YUKIN52840_V1
    bool "Yukin52840_V1"
    depends on SOC_NRF52840_QIAA
```

## config/boards/arm/yukin/yukin52840_v1_defconfig
```kconfig
# SPDX-License-Identifier: MIT

CONFIG_SOC_SERIES_NRF52X=y
CONFIG_SOC_NRF52840_QIAA=y
CONFIG_BOARD_YUKIN52840_V1=y
CONFIG_ZMK_SLEEP=y

# Enable MPU
CONFIG_ARM_MPU=y


# enable GPIO
CONFIG_GPIO=y
CONFIG_PINCTRL=y

# Build configurations
CONFIG_USE_DT_CODE_PARTITION=y
CONFIG_BUILD_OUTPUT_UF2=y

# Flash configuration
CONFIG_MPU_ALLOW_FLASH_WRITE=y
CONFIG_NVS=y
CONFIG_SETTINGS_NVS=y
CONFIG_FLASH=y
CONFIG_FLASH_PAGE_LAYOUT=y
CONFIG_FLASH_MAP=y

# Enable 32kHz crystal
# CONFIG_CLOCK_CONTROL_NRF_K32SRC_XTAL=y
#CONFIG_CLOCK_CONTROL_NRF_K32SRC_30PPM=y

# clock configuration
#CONFIG_CLOCK_CONTROL_NRF=y
#CONFIG_CLOCK_CONTROL_NRF_K32SRC_RC=y


#Backlighting configuration
#CONFIG_PWM=y
#CONFIG_LED_PWM=y
#CONFIG_ZMK_BACKLIGHT=y
#CONFIG_ZMK_BACKLIGHT_ON_START=y
#CONFIG_ZMK_BACKLIGHT_BRT_START=20
#CONFIG_ZMK_BACKLIGHT_AUTO_OFF_IDLE=y
#CONFIG_ZMK_BACKLIGHT_AUTO_OFF_USB=y

# Work-around for Windows bug with battery notifications
# CONFIG_BT_GATT_ENFORCE_SUBSCRIPTION=n

#Misc configuration
# CONFIG_BT_CTLR_TX_PWR_PLUS_8=y
# CONFIG_ZMK_BLE_EXPERIMENTAL_CONN=y
# CONFIG_ZMK_HID_REPORT_TYPE_NKRO=y
# CONFIG_ZMK_HID_CONSUMER_REPORT_USAGES_BASIC=y
CONFIG_ZMK_USB=y
CONFIG_ZMK_BLE=y



# Turn on debugging to disable optimization. Debug messages can result in larger
# stacks, so enable stack protection and particularly a larger BLE peripheral stack.
# CONFIG_DEBUG=y
# CONFIG_DEBUG_THREAD_INFO=y
# CONFIG_EXCEPTION_STACK_TRACE=y
# CONFIG_HW_STACK_PROTECTION=y
# CONFIG_ZMK_SPLIT_BLE_PERIPHERAL_STACK_SIZE=1300
#CONFIG_LOG=y
#CONFIG_ZMK_USB_LOGGING=y
#CONFIG_ZMK_LOG_LEVEL_DBG=y
#CONFIG_LOG_BUFFER_SIZE=65536
#CONFIG_LOG_STRDUP_BUF_COUNT=160
#CONFIG_I2C_LOG_LEVEL_DBG=y
#CONFIG_SPI_LOG_LEVEL_DBG=y
#CONFIG_DISPLAY_LOG_LEVEL_DBG=y
#CONFIG_LVGL_LOG_LEVEL_DBG=y
#CONFIG_LVGL_USE_DEBUG=y
#CONFIG_SENSOR_LOG_LEVEL_DBG=y

# Log via USB or Segger RTT
#CONFIG_ZMK_USB_LOGGING=n
#CONFIG_ZMK_RTT_LOGGING=n
```

## config/boards/shields/yukin70/Kconfig.defconfig
```kconfig
# Copyright (c) 2022 The ZMK Contributors
# SPDX-License-Identifier: MIT

if SHIELD_YUKIN70_LEFT

config ZMK_KEYBOARD_NAME
	default "Yukin70"

config ZMK_SPLIT_BLE_ROLE_CENTRAL
	default y
	
endif

if SHIELD_YUKIN70_LEFT || SHIELD_YUKIN70_RIGHT

config ZMK_SPLIT
	default y

endif
```

## config/boards/shields/yukin70/Kconfig.shield
```kconfig
# Copyright (c) 2022 The ZMK Contributors
# SPDX-License-Identifier: MIT

config SHIELD_YUKIN70_LEFT
	def_bool $(shields_list_contains,yukin70_left)

config SHIELD_YUKIN70_RIGHT
	def_bool $(shields_list_contains,yukin70_right)
```
